## core/Kconfig
```kconfig
mainmenu "4eburNet Configuration"

menu "Protocols"
config EBURNET_VLESS
    bool "VLESS + Reality"
    default y
    help
      VLESS protocol with XTLS-Vision and Reality transport.
      Disable to save ~3KB text.

config EBURNET_TROJAN
    bool "Trojan"
    default y

config EBURNET_SS
    bool "Shadowsocks 2022"
    default y
    help
      Shadowsocks with AEAD-2022 ciphers.
      Disable to save ~4KB text.

config EBURNET_AWG
    bool "AmneziaWG"
    default y
    help
      AmneziaWG (WireGuard obfuscation).
      Disable to save ~6KB text.

config EBURNET_STLS
    bool "ShadowTLS v3 transport"
    default y
    help
      ShadowTLS v3 transport wrapper over Trojan/SS/VLESS.
      HMAC-SHA256 session ID + AppData framing.
endmenu

menu "DNS"
config EBURNET_FAKE_IP
    bool "Fake-IP DNS mode"
    default y

config EBURNET_DOH
    bool "DNS over HTTPS / DNS over TLS"
    default y

config EBURNET_QUIC
    bool "QUIC transport (Hysteria2)"
    default y

config EBURNET_DOQ
    bool "DNS over QUIC (RFC 9250)"
    default n
    depends on EBURNET_QUIC
    help
      DNS over QUIC upstream. Requires wolfSSL --enable-quic.
      Not supported on MICRO profile.
endmenu

menu "Features"

config EBURNET_PROXY_PROVIDERS
    bool "Proxy providers (subscription URLs)"
    default y

config EBURNET_SNIFFER
    bool "TLS SNI sniffer"
    default y

config EBURNET_DPI
    bool "DPI bypass filter (ipset/whitelist/autohosts)"
    default y
    depends on EBURNET_SNIFFER
    help
      Loads /etc/4eburnet/dpi/ipset.txt, whitelist.txt, autohosts.txt
      at startup. Used by DPI bypass strategies (C.2+).
      RAM: ~220 KB. Safe to enable on MICRO.

endmenu
```
